## examples/01-hello-uart/sdkconfig.defaults
```kconfig
# ESP32-P4 通用配置
CONFIG_IDF_TARGET="esp32p4"

# 主频 400MHz
CONFIG_ESP_DEFAULT_CPU_FREQ_MHZ_400=y

# Flash
CONFIG_ESPTOOLPY_FLASHSIZE_16MB=y

# UART 控制台
CONFIG_ESP_CONSOLE_UART_DEFAULT=y
CONFIG_ESP_CONSOLE_UART_BAUDRATE=115200
```

## examples/02-bench-coremark/sdkconfig.defaults
```kconfig
CONFIG_IDF_TARGET="esp32p4"
CONFIG_ESP_DEFAULT_CPU_FREQ_MHZ_400=y
CONFIG_SPIRAM=y
CONFIG_SPIRAM_MODE_OCT=y
CONFIG_SPIRAM_SPEED_200M=y
CONFIG_SPIRAM_USE_MALLOC=y
CONFIG_ESPTOOLPY_FLASHSIZE_16MB=y
CONFIG_ESP_CONSOLE_UART_DEFAULT=y
CONFIG_ESP_CONSOLE_UART_BAUDRATE=115200
```

## examples/04-gpio-blink/sdkconfig.defaults
```kconfig
CONFIG_IDF_TARGET="esp32p4"
CONFIG_ESP_DEFAULT_CPU_FREQ_MHZ_400=y
CONFIG_ESPTOOLPY_FLASHSIZE_16MB=y
CONFIG_ESP_CONSOLE_UART_DEFAULT=y
CONFIG_ESP_CONSOLE_UART_BAUDRATE=115200
# 允许串口输入（getchar）
CONFIG_ESP_CONSOLE_UART=y
```
